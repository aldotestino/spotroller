## main/Kconfig.projbuild
```kconfig
menu "Example Configuration"

    config ESP_WIFI_SSID
        string "WiFi SSID"
        default "myssid"
        help
            SSID (network name) for the example to connect to.

    config ESP_WIFI_PASSWORD
        string "WiFi Password"
        default "mypassword"
        help
            WiFi password (WPA or WPA2) for the example to use.

    config ESP_MAXIMUM_RETRY
        int "Maximum retry"
        default 5
        help
            Set the Maximum retry to avoid station reconnecting to the AP unlimited when the AP is really inexistent.

    config SERIAL_STUDIO_DEBUG
        bool "Enable log that can be parsed by Serial Studio"
        default "n"
        help
            Enable this option, the example will print a string at runtime with a specific format,
            which can be parsed by the Serial Studio tool.
            With the "serial-studio-dashboard.json" template file provided in this example,
            user can observe the speed in a curve window in the Serial Studio.

endmenu
```
